## board/freescale/imx93_evk/Kconfig
```kconfig
if TARGET_IMX93_11X11_EVK || TARGET_IMX93_14X14_EVK

config SYS_BOARD
	default "imx93_evk"

config SYS_VENDOR
	default "freescale"

config SYS_CONFIG_NAME
	default "imx93_phycore" if IMX93_PHYCORE_DDR_TIMING
	default "imx93_evk"

config IMX93_EVK_LPDDR4
	bool "Using LPDDR4 Timing and PMIC voltage"
	select IMX9_LPDDR4X
	help
	  Select the LPDDR4 timing and 1.1V VDDQ

config IMX93_PHYCORE_DDR_TIMING
	bool "Use PHYTEC phyCORE LPDDR4 reference timing"
	depends on IMX93_EVK_LPDDR4
	help
	  Build the PHYTEC phyCORE-i.MX93 reference LPDDR4 timing instead of
	  the timing generated for the i.MX93 EVK board.

config IMX93_EVK_LPDDR4X
	bool "Using LPDDR4X Timing and PMIC voltage"
	depends on !IMX93_EVK_LPDDR4
	default y
	select IMX9_LPDDR4X
	help
	  Select the LPDDR4X timing and 0.6V VDDQ

endif
```

## board/phytec/common/Kconfig
```kconfig
config PHYTEC_SOM_DETECTION
	bool "Support SoM detection for PHYTEC platforms"
	select SPL_CRC8 if SPL
	help
	   Support of I2C EEPROM based SoM detection.

config PHYTEC_IMX8M_SOM_DETECTION
	bool "Support SoM detection for i.MX8M PHYTEC platforms"
	depends on ARCH_IMX8M && PHYTEC_SOM_DETECTION
	default y
	help
	  Support of I2C EEPROM based SoM detection. Supported
	  for PHYTEC i.MX8MM/i.MX8MP boards

config PHYTEC_IMX91_93_SOM_DETECTION
	bool "Support SoM detection for i.MX91/93 PHYTEC platforms"
	depends on ARCH_IMX9 && PHYTEC_SOM_DETECTION
	default y

config PHYTEC_EEPROM_BUS
	int "PHYTEC EEPROM I2C bus"
	depends on PHYTEC_SOM_DETECTION
	default 2
```

## board/phytec/phycore_imx91/Kconfig
```kconfig
config SYS_BOARD
	default "phycore_imx91"
	depends on TARGET_PHYCORE_IMX91

config SYS_VENDOR
	default "phytec"
	depends on TARGET_PHYCORE_IMX91

config SYS_CONFIG_NAME
	default "imx91_phycore"
	depends on TARGET_PHYCORE_IMX91
```

## board/phytec/phycore_imx91_93/Kconfig
```kconfig
if TARGET_PHYCORE_IMX93

config SYS_BOARD
	default "phycore_imx91_93"

config SYS_VENDOR
	default "phytec"

config SYS_CONFIG_NAME
	default "imx93_phycore"

source "board/phytec/common/Kconfig"

endif
```
