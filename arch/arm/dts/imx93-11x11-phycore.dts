// SPDX-License-Identifier: (GPL-2.0+ OR MIT)
/*
 * Copyright 2026 NXP
 */
/dts-v1/;

#include "imx93-phyboard-segin.dts"

/ {
	model = "PHYTEC phyCORE-i.MX93 on i.MX93 11x11 carrier";
	compatible = "phytec,imx93-phyboard-segin", "phytec,imx93-phycore-som",
		     "fsl,imx93";
};

/* U-Boot appends the matching pre-relocation include after this file. */
